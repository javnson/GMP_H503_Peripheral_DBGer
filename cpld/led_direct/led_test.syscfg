/**
 *
 * @cliArgs --device "Other" --part "Other" --package "Other" --product "TPLD@1.8.0+1529"
 * @versions {"tool":"1.28.0+4713"}
 */

/**
 * Define each context separately, before assigning them to individual modules.
 */
const context = await scripting.createContext(["--device", "TPLD2001", "--package", "DGS (VSSOP, 20)", "--variant", "default"]);
{
    const {scripting, system} = context;
    
    /**
     * Import the modules used in this configuration.
     */
    const CNT    = scripting.addModule("/ti/tpld/CNT", {}, false);
    const CNT1   = CNT.addInstance();
    const CNT2   = CNT.addInstance();
    const CNT3   = CNT.addInstance();
    const CNT4   = CNT.addInstance();
    const CNT5   = CNT.addInstance();
    const CNT6   = CNT.addInstance();
    const DFF    = scripting.addModule("/ti/tpld/DFF", {}, false);
    const DFF1   = DFF.addInstance();
    const DFF2   = DFF.addInstance();
    const DFF3   = DFF.addInstance();
    const LUT    = scripting.addModule("/ti/tpld/LUT", {}, false);
    const LUT1   = LUT.addInstance();
    const LUT2   = LUT.addInstance();
    const LUT3   = LUT.addInstance();
    const Label  = scripting.addModule("/ti/tpld/Label", {}, false);
    const Label1 = Label.addInstance();
    const Label2 = Label.addInstance();
    const Label3 = Label.addInstance();
    const Label4 = Label.addInstance();
    const PIN    = scripting.addModule("/ti/tpld/PIN", {}, false);
    const PIN1   = PIN.addInstance();
    const PIN2   = PIN.addInstance();
    const PIN3   = PIN.addInstance();
    const PIN4   = PIN.addInstance();
    const PIN5   = PIN.addInstance();
    const PWM    = scripting.addModule("/ti/tpld/PWM", {}, false);
    const PWM1   = PWM.addInstance();
    const PWM2   = PWM.addInstance();
    const PWM3   = PWM.addInstance();
    const VCC    = scripting.addModule("/ti/tpld/VCC", {}, false);
    const VCC1   = VCC.addInstance();
    
    /**
     * Write custom configuration values to the imported modules.
     */
    CNT4.$name      = "cnt3";
    CNT4.edge_sel   = 3;
    CNT4.data       = 254;
    CNT4.clk_sel2   = "OSC1/64";
    CNT4.hw.$assign = "LUT3_10";
    
    CNT5.$name    = "cnt4";
    CNT5.edge_sel = 3;
    CNT5.data     = 254;
    CNT5.clk_sel2 = "OSC1/64";
    
    CNT6.$name    = "cnt5";
    CNT6.edge_sel = 3;
    CNT6.data     = 254;
    CNT6.clk_sel2 = "OSC1/64";
    
    DFF1.$name      = "dff0";
    DFF1.init_pol   = 1;
    DFF1.hw.$assign = "LUT2_2";
    
    DFF2.$name      = "dff1";
    DFF2.hw.$assign = "LUT2_1";
    
    DFF3.$name      = "dff2";
    DFF3.hw.$assign = "LUT2_0";
    
    LUT1.$name      = "lut0";
    LUT1.function   = "NAND";
    LUT1.hw.$assign = "LUT4_1";
    
    LUT2.$name      = "lut1";
    LUT2.function   = "NAND";
    LUT2.hw.$assign = "LUT4_2";
    
    LUT3.$name      = "lut2";
    LUT3.function   = "NAND";
    LUT3.hw.$assign = "LUT4_3";
    
    Label1.$name = "Transfer control bit (1) through flip flops when the button is pressed";
    
    Label2.$name = "Disable reset for the counter with the control bit enabled when the button is pressed";
    
    Label3.$name = "Divide PWM counter to human-readible level";
    
    Label4.$name = "Only one PWM generator changes duty cycle at a time.\nThe others are held at a constant duty cycle.\n";
    
    PIN1.$name      = "Input";
    PIN1.hw.$assign = "IO12";
    
    PIN2.type       = "DOUT";
    PIN2.$name      = "Green";
    PIN2.hw.$assign = "IO4";
    
    PIN3.type       = "DOUT";
    PIN3.$name      = "Red";
    PIN3.hw.$assign = "IO5";
    
    PIN4.type       = "DOUT";
    PIN4.$name      = "Blue";
    PIN4.hw.$assign = "IO8";
    
    PIN5.$name      = "pin0";
    PIN5.type       = "DOUT";
    PIN5.hw.$assign = "IO11";
    
    PWM1.$name        = "pwm0";
    PWM1.pwm_clk_sel2 = "OSC1/1";
    PWM1.hw.$assign   = "PWM_GEN0";
    
    CNT1.$name      = "cnt0";
    PWM1.fsm        = CNT1;
    CNT1.data       = 255;
    CNT1.clk_sel2   = "OSC1/64";
    CNT1.hw.$assign = "CNT6_FSM0";
    
    PWM2.$name        = "pwm1";
    PWM2.dc_sel       = 1;
    PWM2.pwm_clk_sel2 = "OSC1/1";
    PWM2.hw.$assign   = "PWM_GEN1";
    
    CNT2.$name      = "cnt1";
    PWM2.fsm        = CNT2;
    CNT2.data       = 255;
    CNT2.clk_sel2   = "OSC1/64";
    CNT2.hw.$assign = "CNT7_FSM1";
    
    PWM3.$name        = "pwm2";
    PWM3.dc_sel       = 2;
    PWM3.pwm_clk_sel2 = "OSC1/1";
    
    CNT3.$name      = "cnt2";
    PWM3.fsm        = CNT3;
    CNT3.data       = 255;
    CNT3.clk_sel2   = "OSC1/64";
    CNT3.hw.$assign = "CNT8_FSM2";
    
    const OSC2  = scripting.addModule("/ti/tpld/OSC2", {}, false);
    const OSC21 = OSC2.addInstance({}, false);
    OSC21.$name = "2MHz0";
    CNT4.osc    = OSC21;
    CNT5.osc    = OSC21;
    CNT6.osc    = OSC21;
    CNT1.osc    = OSC21;
    CNT2.osc    = OSC21;
    CNT3.osc    = OSC21;
    
    const SYSTEM = scripting.addModule("/ti/tpld/SYSTEM", {}, false);
    
    VCC1.$name = "VCC0";
    
    /**
     * Connections between modules.
     */
    scripting.connect(CNT4, "IN", LUT1, "OUT");
    scripting.connect(CNT4, "OUT", CNT1, "KEEP");
    scripting.connect(CNT5, "IN", LUT2, "OUT");
    scripting.connect(CNT5, "OUT", CNT2, "KEEP");
    scripting.connect(CNT6, "IN", LUT3, "OUT");
    scripting.connect(CNT6, "OUT", CNT3, "KEEP");
    scripting.connect(DFF1, "IN", DFF3, "OUT");
    scripting.connect(DFF1, "CLK", PIN1, "OUT");
    scripting.connect(DFF1, "OUT", LUT1, "B");
    scripting.connect(DFF1, "OUT", DFF2, "IN");
    scripting.connect(DFF2, "CLK", PIN1, "OUT");
    scripting.connect(DFF2, "OUT", LUT2, "B");
    scripting.connect(DFF2, "OUT", DFF3, "IN");
    scripting.connect(DFF3, "CLK", PIN1, "OUT");
    scripting.connect(DFF3, "OUT", LUT3, "B");
    scripting.connect(LUT1, "A", PIN1, "OUT");
    scripting.connect(LUT2, "A", PIN1, "OUT");
    scripting.connect(LUT3, "A", PIN1, "OUT");
    scripting.connect(PIN1, "OUT", PIN5, "IN");
    scripting.connect(PIN2, "IN", PWM1, "OUT0");
    scripting.connect(PIN3, "IN", PWM2, "OUT0");
    scripting.connect(PIN4, "IN", PWM3, "OUT0");
    scripting.connect(PWM1, "PDWN", VCC1, "OUT");
    scripting.connect(PWM2, "PDWN", VCC1, "OUT");
    scripting.connect(PWM3, "PDWN", VCC1, "OUT");
    
    /**
     * (x,y) coordinates for modules that are displayed in a graph.
     */
    CNT4.$position   = [-315,0];
    CNT5.$position   = [-315,100];
    CNT6.$position   = [-315,220];
    DFF1.$position   = [-630,-5];
    DFF2.$position   = [-640,105];
    DFF3.$position   = [-625,230];
    LUT1.$position   = [-480,-15];
    LUT2.$position   = [-480,95];
    LUT3.$position   = [-475,220];
    Label1.$position = [-670,-125];
    Label2.$position = [-440,320];
    Label3.$position = [-310,-45];
    Label4.$position = [10,-140];
    PIN1.$position   = [-820,-55];
    PIN2.$position   = [135,-20];
    PIN3.$position   = [130,90];
    PIN4.$position   = [135,215];
    PIN5.$position   = [-460,-100];
    PWM1.$position   = [0,-25];
    CNT1.$position   = [-170,-5];
    PWM2.$position   = [0,85];
    CNT2.$position   = [-170,95];
    PWM3.$position   = [5,210];
    CNT3.$position   = [-170,220];
    OSC21.$position  = [-420,155];
    VCC1.$position   = [-70,-80];
    
    /**
     * Pinmux solution for unlocked pins/peripherals. This ensures that minor changes to the automatic solver in a future
     * version of the tool will not impact the pinmux you originally saw.  These lines can be completely deleted in order to
     * re-solve from scratch.
     */
    CNT5.hw.$suggestSolution   = "LUT3_8";
    CNT6.hw.$suggestSolution   = "CNT9_FSM3";
    PWM3.hw.$suggestSolution   = "PWM_GEN2";
    OSC21.hw.$suggestSolution  = "OSC1";
    SYSTEM.hw.$suggestSolution = "MISC";
    
}


/**
 * Import the modules used in this configuration.
 */
const Device     = scripting.addModule("/ti/tpld/Device", {}, false);
const Device1    = Device.addInstance();
const GND        = scripting.addModule("/ti/tpld/GND", {}, false);
const GND1       = GND.addInstance();
const Simulation = scripting.addModule("/ti/tpld/Simulation");
const VCC        = scripting.addModule("/ti/tpld/VCC", {}, false);
const VCC1       = VCC.addInstance();

/**
 * Write custom configuration values to the imported modules.
 */
Device1.$name     = "U0";
Device1.context   = context;
Device1.$topLabel = "Due to this design being in human\ntimescale we recommend loading onto the EVM\nfor testing";
scripting.probe(Device1, "$context.Input.IN_EXT", ["voltage"]);
scripting.probe(Device1, "$context.Green.OUT_EXT", ["voltage"]);
scripting.probe(Device1, "$context.Red.OUT_EXT", ["voltage"]);
scripting.probe(Device1, "$context.Blue.OUT_EXT", ["voltage"]);

GND1.$name = "GND0";

Simulation.tstop = { val: 1, units: "s" };
Simulation.tstep = { val: 1, units: "ms" };

VCC1.$name = "VCC0";

/**
 * Connections between modules.
 */
scripting.connect(Device1, "VCC", VCC1, "OUT");
scripting.connect(Device1, "GND", GND1, "OUT");

/**
 * (x,y) coordinates for modules that are displayed in a graph.
 */
Device1.$position = [0,0];
GND1.$position    = [-140,50];
VCC1.$position    = [-180,-10];
